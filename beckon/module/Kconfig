## beckon/module/Kconfig
```kconfig
menuconfig BECKON_STATUS_TRANSPORT
    bool "Beckon host status transport"
    depends on RAW_HID
    help
      Receive declarative agent-status snapshots from the host on the split
      central's vendor-defined Raw HID interface. This never accepts key,
      behavior, or other control commands.

config BECKON_STATUS_LED_PROOF
    bool "Beckon F1 status LED proof"
    depends on ZMK_RGB_UNDERGLOW
    default n
    help
      Render snapshot slot 0 on the Glove80 left-half F1 and slot 5 on the
      right-half F6. The right-half indicator receives the same snapshot
      through ZMK's authenticated split transport, never Raw HID over BLE.

config BECKON_STATUS_LED_LAYER
    int "Keymap layer that displays Beckon status LEDs"
    depends on BECKON_STATUS_LED_PROOF
    default 4

config BECKON_STATUS_SPLIT_SYNC
    bool "Synchronize Beckon status to split peripheral"
    depends on BECKON_STATUS_LED_PROOF && ZMK_SPLIT_BLE
    default y
    help
      Send a compact status snapshot through the existing encrypted ZMK split
      service so right-half LEDs can render F6-F10. This adds no host-visible
      Bluetooth HID or Raw HID endpoint.
```
